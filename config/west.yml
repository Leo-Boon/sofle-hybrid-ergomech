## config/west.yml
```yaml
manifest:
  remotes:
    - name: zmkfirmware
      url-base: https://github.com/zmkfirmware
    - name: pointers-move-scroll
      url-base: https://github.com/petejohanson/zmk
  projects:
    - name: zmk
      remote: petejohanson
      revision: main
      import: app/west.yml
    - name: pointers-move-scroll
      remote: petejohanson
      revision: main
  self:
    path: config
```
